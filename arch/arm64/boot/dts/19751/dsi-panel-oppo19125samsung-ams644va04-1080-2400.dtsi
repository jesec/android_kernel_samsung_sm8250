/* Copyright (c) 2014-2018, The Linux Foundation. All rights reserved.
 *
 * This program is free software; you can redistribute it and/or modify
 * it under the terms of the GNU General Public License version 2 and
 * only version 2 as published by the Free Software Foundation.
 *
 * This program is distributed in the hope that it will be useful,
 * but WITHOUT ANY WARRANTY; without even the implied warranty of
 * MERCHANTABILITY or FITNESS FOR A PARTICULAR PURPOSE.  See the
 * GNU General Public License for more details.
 */

&mdss_mdp {
	dsi_oppo19125samsung_ams644va04_1080_2400_video: qcom,mdss_dsi_oppo19125samsung_ams644va04_1080_2400_video {
		qcom,mdss-dsi-panel-name =
		  "samsung ams644va04 amoled fhd+ panel";
		qcom,mdss-dsi-panel-type = "dsi_video_mode";
		qcom,mdss-dsi-virtual-channel-id = <0>;
		qcom,mdss-dsi-stream = <0>;
		qcom,mdss-dsi-bpp = <24>;
		qcom,mdss-dsi-color-order = "rgb_swap_rgb";
		qcom,mdss-dsi-underflow-color = <0xff>;
		qcom,mdss-dsi-border-color = <0>;

		qcom,dsi-ctrl-num = <0>;
		qcom,dsi-phy-num = <0>;
		qcom,dsi-select-clocks = "src_byte_clk0", "src_pixel_clk0";

		qcom,mdss-dsi-traffic-mode = "non_burst_sync_event";
		qcom,mdss-dsi-lane-map = "lane_map_0123";
		qcom,mdss-dsi-bllp-eof-power-mode;
		qcom,mdss-dsi-bllp-power-mode;
		qcom,mdss-dsi-lane-0-state;
		qcom,mdss-dsi-lane-1-state;
		qcom,mdss-dsi-lane-2-state;
		qcom,mdss-dsi-lane-3-state;
		qcom,mdss-dsi-dma-trigger = "trigger_sw";
		qcom,mdss-dsi-mdp-trigger = "none";
		qcom,mdss-dsi-reset-sequence = <1 10>, <0 10>, <1 10>;
		qcom,mdss-dsi-te-pin-select = <1>;
		qcom,mdss-dsi-wr-mem-start = <0x2c>;
		qcom,mdss-dsi-wr-mem-continue = <0x3c>;
		qcom,mdss-dsi-te-dcs-command = <1>;
		qcom,mdss-dsi-te-check-enable;
		qcom,mdss-dsi-te-using-te-pin;
		qcom,mdss-dsi-panel-hdr-enabled;
		qcom,mdss-dsi-panel-hdr-color-primaries = <15000 15500 34000
			16000 13250 34500 7500 3000>;
		qcom,mdss-dsi-panel-peak-brightness = <4300000>;
		qcom,mdss-dsi-panel-blackness-level = <1023>;
		qcom,dsi-dyn-clk-enable;
		qcom,dsi-dyn-clk-list = <1107000000 1124000000>;

		qcom,mdss-dsi-display-timings {
			timing@0{
				//qcom,mdss-dsi-panel-clockrate = <1058000000>;
				qcom,mdss-dsi-panel-framerate = <61>;
				qcom,mdss-dsi-panel-width = <1080>;
				qcom,mdss-dsi-panel-height = <2400>;
				qcom,mdss-dsi-h-front-porch = <80>;
				qcom,mdss-dsi-h-back-porch = <90>;
				qcom,mdss-dsi-h-pulse-width = <20>;
				qcom,mdss-dsi-h-sync-skew = <0>;
				qcom,mdss-dsi-h-sync-pulse = <0>;
				qcom,mdss-dsi-v-back-porch = <12>;
				qcom,mdss-dsi-v-front-porch = <3>;
				qcom,mdss-dsi-v-pulse-width = <1>;
				qcom,mdss-dsi-h-left-border = <0>;
				qcom,mdss-dsi-h-right-border = <0>;
				qcom,mdss-dsi-v-top-border = <0>;
				qcom,mdss-dsi-v-bottom-border = <0>;
				qcom,mdss-dsi-panel-jitter = <0xa 0x1>;

				qcom,mdss-dsi-on-command = [
					05 01 00 00 14 00 01 11
					15 01 00 00 00 00 02 35 00
					/* FAIL SAFE Setting */
					39 01 00 00 00 00 03 FC 5A 5A
					39 01 00 00 00 00 0D ED 00 01 00 40 04 08 A8 84 4A 73 02 0A
					39 01 00 00 00 00 03 FC A5 A5
					/* ELVSS Dim Setting */
					39 01 00 00 00 00 03 F0 5A 5A
					15 01 00 00 00 00 02 B0 05
					15 01 00 00 00 00 02 B3 07
					39 01 00 00 00 00 03 F0 A5 A5
					/* ACL Mode */
					39 01 00 00 00 00 02 55 00
					39 01 00 00 00 00 02 53 28
					39 01 00 00 00 00 03 F0 5A 5A
					15 01 00 00 00 00 02 F2 0F
					39 01 00 00 64 00 03 F0 A5 A5
					];
				qcom,mdss-dsi-post-on-backlight = [
					05 01 00 00 00 00 01 29
					];
				qcom,mdss-dsi-off-command = [
					05 01 00 00 0A 00 01 28
					05 01 00 00 78 00 01 10
					];
				qcom,mdss-dsi-lp1-command = [
					39 01 00 00 00 00 03 51 00 01
					15 01 00 00 00 00 02 53 20
					];
				qcom,mdss-dsi-nolp-command = [
					39 01 00 00 00 00 02 53 20
					05 01 00 00 00 00 01 29
					];
				qcom,mdss-dsi-aod-hbm-on-command = [
					39 01 00 00 00 00 03 51 0F FF
					15 01 00 00 00 00 02 53 E0];
				qcom,mdss-dsi-aod-hbm-off-command = [
					15 01 00 00 00 00 02 53 20];
				qcom,mdss-dsi-aod-high-mode-command = [
					39 01 00 00 00 00 03 51 00 40
				];
				qcom,mdss-dsi-aod-low-mode-command = [
					39 01 00 00 00 00 03 51 00 04
				];
				qcom,mdss-dsi-hbm-on-command = [
					39 01 00 00 00 00 03 51 0F FF
					15 01 00 00 22 00 02 53 E0];
				qcom,mdss-dsi-hbm-off-command = [
					15 01 00 00 00 00 02 53 20];
				qcom,mdss-dsi-seed-off-command = [
					/* CRC OFF */
					39 01 00 00 00 00 03 F0 5A 5A
					15 01 00 00 00 00 02 80 01
					39 01 00 00 00 00 03 F0 A5 A5
				];
				qcom,mdss-dsi-seed-0-command = [
					/* SEED CRC Setting */
					39 01 00 00 00 00 03 F0 5A 5A
					39 01 00 00 00 00 02 80 90
					39 01 00 00 00 00 02 B1 00
					/* SEED CRC P3 RGB */
					39 01 00 00 00 00 03 B0 01 B1
					39 01 00 00 00 00 16 B1
					   FF 00 00 00 FF 00 00 00 FF
					   00 FF FF FF 00 FF FF FF 00
					   FF FF FF
					/* SEED CRC ON */
					39 01 00 00 00 00 03 B0 55 B1
					39 01 00 00 00 00 02 B1 80
					39 01 00 00 00 00 03 F0 A5 A5
				];
				qcom,mdss-dsi-seed-1-command = [
					/* SEED CRC Setting */
					39 01 00 00 00 00 03 F0 5A 5A
					39 01 00 00 00 00 02 80 90
					39 01 00 00 00 00 02 B1 00
					/* SEED CRC P3 RGB */
					39 01 00 00 00 00 03 B0 01 B1
					39 01 00 00 00 00 16 B1
					   FF 00 00 00 FF 00 00 00 FF
					   00 FF FF FF 00 FF FF FF 00
					   FF FF FF
					/* SEED CRC ON */
					39 01 00 00 00 00 03 B0 55 B1
					39 01 00 00 00 00 02 B1 80
					39 01 00 00 00 00 03 F0 A5 A5
				];
				qcom,mdss-dsi-seed-2-command = [
					/* SEED CRC Setting */
					39 01 00 00 00 00 03 81 31 02
					39 01 00 00 00 00 03 F0 5A 5A
					/* SEED CRC SRGB RGB */
					15 01 00 00 00 00 02 B0 2B
					39 01 00 00 00 00 16 B1
					   A2 0E 03 33 C5 12 0A 00 AE
					   44 DE CC BB 11 B8 DE DE 17
					   FF FF FF
					/* SEED CRC ON */
					15 01 00 00 00 00 02 B1 00
					39 01 00 00 00 00 03 F0 A5 A5
				];
				qcom,mdss-dsi-lp1-command-state = "dsi_hs_mode";
				qcom,mdss-dsi-nolp-command-state = "dsi_hs_mode";
				qcom,mdss-dsi-post-on-backlight-state = "dsi_hs_mode";
				qcom,mdss-dsi-on-command-state = "dsi_hs_mode";
				qcom,mdss-dsi-off-command-state = "dsi_hs_mode";
			};
		};
	};
};

&dsi_oppo19125samsung_ams644va04_1080_2400_video {
	qcom,panel-supply-entries = <&dsi_panel_pwr_supply>;
	qcom,mdss-dsi-bl-pmic-control-type = "bl_ctrl_dcs";
	qcom,mdss-dsi-bl-min-level = <1>;
	qcom,mdss-dsi-bl-max-level = <1023>;
	qcom,mdss-brightness-max-level = <1023>;
	qcom,platform-te-gpio = <&tlmm 10 0>;
	qcom,platform-reset-gpio = <&pm8150l_gpios 3 0>;
	qcom,ulps-enabled;
	qcom,dsi-select-clocks = "mux_byte_clk0", "mux_pixel_clk0",
				"src_byte_clk0", "src_pixel_clk0",
				"shadow_byte_clk0", "shadow_pixel_clk0";
	qcom,mdss-dsi-t-clk-post = <0x0e>;
	qcom,mdss-dsi-t-clk-pre = <0x35>;
	qcom,mdss-dsi-display-timings {
		timing@0{
			qcom,mdss-dsi-panel-phy-timings = [00 14 05 05 1f 1e 05
				05 03 02 04 00 12 15];

			qcom,display-topology = <1 0 1>;
			qcom,default-topology-index = <0>;
		};
	};
};
