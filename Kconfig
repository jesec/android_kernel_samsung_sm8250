## Kconfig
```kconfig
# SPDX-License-Identifier: GPL-2.0
#
# For a description of the syntax of this configuration file,
# see Documentation/kbuild/kconfig-language.txt.
#
mainmenu "Linux/$(ARCH) $(KERNELVERSION) Kernel Configuration"

comment "Compiler: $(CC_VERSION_TEXT)"

#ifdef VENDOR_EDIT
#Wen.Luo@Bsp.Kernel.Stability, 2018/12/05, Add for aging test, slub debug config
config OPPO_SLUB_TEST
	string
	default "$(OPPO_SLUB_TEST)"

config OPPO_KASAN_TEST
	string
	default "$(OPPO_KASAN_TEST)"

config OPPO_KMEMLEAK_TEST
	string
	default "$(OPPO_KMEMLEAK_TEST)"

config OPPO_AGING_TEST
	string
	default "$(OPPO_AGING_TEST)"

config OPPO_PAGEOWNER_TEST
	string
	default "$(OPPO_PAGEOWNER_TEST)"
#endif

source "scripts/Kconfig.include"

source "init/Kconfig"

source "kernel/Kconfig.freezer"

source "fs/Kconfig.binfmt"

source "mm/Kconfig"

source "net/Kconfig"

source "drivers/Kconfig"

source "fs/Kconfig"

source "security/Kconfig"

source "crypto/Kconfig"

source "lib/Kconfig"

source "lib/Kconfig.debug"

config OPPO_AGING_DEBUG_CONFIG
	bool "oppo aging config"
	select DEBUG_SPINLOCK
	select DEBUG_MUTEXES
	select IPC_LOGGING
	select QCOM_RTB
	select QCOM_RTB_SEPARATE_CPUS
	select DEBUG_LIST
	default y if OPPO_AGING_TEST = "true"
	default n
```

## arch/arm64/Kconfig.canvas
```kconfig
#
# Samsung Canvas Projects
#
config MACH_C2Q_USA_SINGLE
	default n
	bool "Samsung C2Q USA SQ"
	help
	  Support for Samsung C2Q USA SQ device.
```

## arch/arm64/Kconfig.projects
```kconfig
config SEC_X1Q_PROJECT
	depends on ARCH_KONA
	select SLUB_DEBUG if SEC_FACTORY
	select SLUB_DEBUG_ON if SEC_FACTORY
	default n
	bool "Samsung X1Q Project"
	help
	  Support for Samsung X1Q Project

config SEC_Y2Q_PROJECT
	depends on ARCH_KONA
	select SLUB_DEBUG if SEC_FACTORY
	select SLUB_DEBUG_ON if SEC_FACTORY
	default n
	bool "Samsung Y2Q Project"
	help
	  Support for Samsung Y2Q Project

config SEC_Z3Q_PROJECT
	depends on ARCH_KONA
	select SLUB_DEBUG if SEC_FACTORY
	select SLUB_DEBUG_ON if SEC_FACTORY
	default n
	bool "Samsung Z3Q Project"
	help
	  Support for Samsung Z3Q Project

menu "Samsung X/Y/Z"
depends on SEC_X1Q_PROJECT || SEC_Y2Q_PROJECT || SEC_Z3Q_PROJECT
source "arch/arm64/Kconfig.xyz
endmenu
```

## arch/arm64/Kconfig.winner2
```kconfig
#
# Samsung Winner2 Projects
#
config MACH_WIN2Q_EUR_OPEN
	default n
	bool "Samsung WIN2Q EUR OPEN"
	help
	  Support for Samsung WIN2Q EUR OPEN device.
```

## arch/arm64/configs/vendor/variant_c2q_defconfig
```kconfig
# CONFIG_SEC_X1Q_PROJECT is not set
# CONFIG_MACH_X1Q_CHN_OPEN is not set

CONFIG_SEC_C2Q_PROJECT=y
CONFIG_MACH_C2Q_USA_SINGLE=y

CONFIG_CONNECTOR=y

CONFIG_WLAN_BCM4375_ADVANCED_FEATURES=y

# CONFIG_TOUCHSCREEN_SEC_TS_Y79A is not set
CONFIG_TOUCHSCREEN_SEC_TS_Y79A_C=y

CONFIG_INPUT_WACOM=y
CONFIG_EPEN_WACOM_W9020=y

# CONFIG_SAMSUNG_SBI is not set
CONFIG_SAMSUNG_OIS_TAMODE_CONTROL=y
# CONFIG_SAMSUNG_REAR_TELE_BINNING is not set
# CONFIG_CAMERA_SSM_I2C_ENV is not set
CONFIG_SAMSUNG_REAR_TELE_TETRA=y
CONFIG_SAMSUNG_ACTUATOR_PREVENT_SHAKING=y

# CONFIG_PANEL_S6E3HA9_AMB611WE01_WQHD is not set
# CONFIG_PANEL_S6E3HA9_AMB644WF01_WQHD is not set
# CONFIG_PANEL_S6E3HAB_AMB623TS01_WQHD is not set
CONFIG_PANEL_S6E3HAB_AMB687TZ01_WQHD=y
CONFIG_PANEL_S6E3HAC_AMB687VX01_WQHD=y

CONFIG_SAMSUNG_UWB=y
CONFIG_UWB_SR100=y
CONFIG_SEC_UWB_LOGGER=y

CONFIG_DSP_SLEEP_RECOVERY=y

CONFIG_WIRELESS_CHARGER_MFC_S2MIW04=y

CONFIG_SENSORS_VL53L5=y
CONFIG_SENSORS_VL53L5_SUPPORT_UAPI=y

CONFIG_SUPPORT_PROX_INIT_CAL=y
CONFIG_SUPPORT_HIDDEN_HOLE=y

CONFIG_MST_LDO=y
CONFIG_MST_V2=y
CONFIG_MFC_CHARGER=y
```

## arch/arm64/configs/vendor/variant_c2q_usa_openx_defconfig
```kconfig
# CONFIG_SEC_C1Q_PROJECT is not set
CONFIG_SEC_C2Q_PROJECT=y
# CONFIG_SEC_X1Q_PROJECT is not set
# CONFIG_SEC_Y2Q_PROJECT is not set
# CONFIG_SEC_Z3Q_PROJECT is not set

CONFIG_MACH_C2Q_USA_SINGLE=y
# CONFIG_MACH_Y2Q_KOR_SINGLE is not set
# CONFIG_MACH_Y2Q_USA_SINGLE is not set
# CONFIG_MACH_Y2Q_CAN_SINGLE is not set
# CONFIG_MACH_Y2Q_CHN_OPEN is not set
# CONFIG_MACH_Y2Q_JPN_SINGLE is not set
# CONFIG_MACH_X1Q_CHN_OPEN is not set

# CONFIG_MSM_BT_POWER is not set
# CONFIG_BTFM_SLIM is not set
# CONFIG_BT_SLIM_QCA6390 is not set

CONFIG_CONNECTOR=y
CONFIG_PROC_EVENTS=y

CONFIG_SEC_DEBUG_TSP_LOG=y

CONFIG_WLAN_BCM4375_ADVANCED_FEATURES=y

# CONFIG_TOUCHSCREEN_SEC_TS_Y79A is not set
CONFIG_TOUCHSCREEN_SEC_TS_Y79A_C=y

CONFIG_INPUT_WACOM=y
CONFIG_EPEN_WACOM_W9020=y

CONFIG_SAMSUNG_OIS_TAMODE_CONTROL=y
# CONFIG_SAMSUNG_SBI is not set
# CONFIG_SAMSUNG_REAR_TOF is not set
# CONFIG_SAMSUNG_REAR_TELE_BINNING is not set
# CONFIG_CAMERA_SSM_I2C_ENV is not set
CONFIG_SAMSUNG_REAR_TELE_TETRA=y
CONFIG_SAMSUNG_ACTUATOR_PREVENT_SHAKING=y

CONFIG_SAMSUNG_REAR_TOF=y

# CONFIG_PANEL_S6E3HA9_AMB611WE01_WQHD is not set
# CONFIG_PANEL_S6E3HA9_AMB644WF01_WQHD is not set
# CONFIG_PANEL_S6E3HAB_AMB677TY01_WQHD is not set
# CONFIG_PANEL_S6E3HAB_AMB623TS01_WQHD is not set
CONFIG_PANEL_S6E3HAB_AMB687TZ01_WQHD=y
CONFIG_PANEL_S6E3HAC_AMB687VX01_WQHD=y

CONFIG_SAMSUNG_UWB=y
CONFIG_UWB_SR100=y
CONFIG_SEC_UWB_LOGGER=y

CONFIG_ION_RBIN_HEAP_EXCEPTION=y

CONFIG_DSP_SLEEP_RECOVERY=y
# CONFIG_DSP_SLEEP_RECOVERY_FOR_ADSP is not set

# CONFIG_SLIMBUS=y

CONFIG_WIRELESS_CHARGER_MFC_S2MIW04=y

CONFIG_SUPPORT_PROX_INIT_CAL=y
CONFIG_SUPPORT_HIDDEN_HOLE=y

CONFIG_DEFEX_KERNEL_ONLY=y
```

## arch/arm64/configs/vendor/variant_f2q_defconfig
```kconfig
# CONFIG_SEC_X1Q_PROJECT is not set
# CONFIG_MACH_X1Q_CHN_OPEN is not set

CONFIG_SEC_F2Q_PROJECT=y
CONFIG_MACH_F2Q_KOR_SINGLE=y

CONFIG_MSM_BT_POWER=y
CONFIG_BT_SLIM_QCA6490=y

# CONFIG_WLAN_VENDOR_BROADCOM is not set
CONFIG_QCA_CLD_WLAN=y
CONFIG_WCNSS_MEM_PRE_ALLOC=y
CONFIG_CLD_LL_CORE=y
CONFIG_CNSS2=y
CONFIG_CNSS2_DEBUG=y
CONFIG_CNSS2_QMI=y
CONFIG_CNSS_ASYNC=y
CONFIG_BUS_AUTO_SUSPEND=y
CONFIG_CNSS_QCA6490=y
CONFIG_CNSS_GENL=y

CONFIG_FOLDER_HALL=y

# CONFIG_TOUCHSCREEN_SEC_TS_Y79A is not set
CONFIG_TOUCHSCREEN_DUAL_FOLDABLE=y
CONFIG_TOUCHSCREEN_SEC_TS_Y771_SUB=y
CONFIG_TOUCHSCREEN_FTS9CU80F_B=y

CONFIG_GPIO_PCAL6524=y

CONFIG_SAMSUNG_FRONT_TOP=y
CONFIG_SAMSUNG_FRONT_TOP_EEPROM=y
# CONFIG_SAMSUNG_REAR_TELE_BINNING is not set
# CONFIG_USE_CAMERA_HW_BIG_DATA is not set
# CONFIG_CAMERA_SSM_I2C_ENV is not set
CONFIG_SAMSUNG_REAR_TELE_TETRA=y

# CONFIG_PANEL_S6E3HA9_AMB611WE01_WQHD is not set
# CONFIG_PANEL_S6E3HA9_AMB644WF01_WQHD is not set
# CONFIG_PANEL_S6E3HAB_AMB623TS01_WQHD is not set
CONFIG_PANEL_S6E3XA0_AMB729WA01_QXGA=y
CONFIG_PANEL_S6E3FA7_AMB458WJ01_HD=y
CONFIG_PANEL_S6E3XA1_AMF759VG01_QXGA=y
CONFIG_PANEL_S6E3FA7_AMB623VH01_HD=y

# CONFIG_SND_SOC_CS35L41 is not set
CONFIG_SND_SOC_CS35L41_3SPK=y

CONFIG_SAMSUNG_UWB=y
CONFIG_UWB_SR100=y
CONFIG_SEC_UWB_LOGGER=y

CONFIG_DSP_SLEEP_RECOVERY=y
CONFIG_SLIMBUS_MSM_NGD=y

# CONFIG_PD_CHARGER_HV_DISABLE is not set

CONFIG_SWITCHING_S2ASL01=y
CONFIG_DUAL_BATTERY=y
CONFIG_DUAL_BATTERY_CELL_SENSING=y
CONFIG_TX_5V_DISABLE=y
CONFIG_TX_GEAR_PHM_VOUT_CTRL=y

# CONFIG_SENSORS_SX9360 is not set
CONFIG_SENSORS_SX9330_SUB2=y
CONFIG_SENSORS_SX9360_SUB3=y
CONFIG_SUPPORT_MCC_THRESHOLD_CHANGE=y

# CONFIG_TMD490X_FACTORY is not set
# CONFIG_SUPPORT_TMD4907_FACTORY is not set
# CONFIG_SUPPORT_AMS_LIGHT_LCD_VERSION_DUALIZAION is not set
# CONFIG_SUPPORT_AMS_LIGHT_CALIBRATION is not set
# CONFIG_SUPPORT_AMS_PROX_CALIBRATION is not set
# CONFIG_SUPPORT_PROX_AUTO_CAL is not set
CONFIG_SUPPORT_DUAL_DDI_COPR_FOR_LIGHT_SENSOR=y
CONFIG_SUPPORT_BRIGHT_COMPENSATION_LUX=y
CONFIG_SUPPORT_DUAL_6AXIS=y
CONFIG_SUPPORT_DUAL_OPTIC=y
CONFIG_SUPPORT_VIRTUAL_OPTIC=y
CONFIG_SUPPORT_AK0997X=y
CONFIG_SUPPORT_DEVICE_MODE=y
CONFIG_SUPPORT_TMD4907_STK33610_FACTORY=y
CONFIG_SUPPORT_LIGHT_MAIN2_SENSOR=y

CONFIG_CC_ATTACH_LOG=y
CONFIG_REDRIVER=y
CONFIG_COMBO_REDRIVER_PTN36502=y

# CONFIG_SENSORS_QBT2000 is not set
CONFIG_SENSORS_ET5XX=y

CONFIG_MST_LDO=y
CONFIG_MST_V2=y
CONFIG_MFC_CHARGER=y
```

## arch/arm64/configs/vendor/variant_y2q_chn_openx_defconfig
```kconfig
# CONFIG_SEC_X1Q_PROJECT is not set
CONFIG_SEC_Y2Q_PROJECT=y
# CONFIG_SEC_Z3Q_PROJECT is not set

# CONFIG_MACH_Y2Q_KOR_SINGLE is not set
# CONFIG_MACH_Y2Q_USA_SINGLE is not set
# CONFIG_MACH_Y2Q_CAN_SINGLE is not set
CONFIG_MACH_Y2Q_CHN_OPEN=y
# CONFIG_MACH_Y2Q_JPN_SINGLE is not set

CONFIG_MSM_BT_POWER=y
CONFIG_BTFM_SLIM=y
CONFIG_BT_SLIM_QCA6390=y

CONFIG_OF_SLIMBUS=y

CONFIG_SLIMBUS=y
# CONFIG_SLIMBUS_MSM_CTRL is not set
CONFIG_SLIMBUS_MSM_NGD=y

CONFIG_SAMSUNG_REAR_TOF=y

CONFIG_PANEL_S6E3HA9_AMB611WE01_WQHD=y
CONFIG_PANEL_S6E3HA9_AMB644WF01_WQHD=y
CONFIG_PANEL_S6E3HAB_AMB677TY01_WQHD=y
# CONFIG_PANEL_S6E3HAB_AMB623TS01_WQHD is not set
# CONFIG_PANEL_S6E3HAB_AMB687TZ01_WQHD is not set
```

## arch/arm64/configs/vendor/variant_z3q_chn_openx_defconfig
```kconfig
# CONFIG_SEC_X1Q_PROJECT is not set
# CONFIG_SEC_Y2Q_PROJECT is not set
CONFIG_SEC_Z3Q_PROJECT=y

# CONFIG_MACH_Z3Q_KOR_SINGLE is not set
# CONFIG_MACH_Z3Q_USA_SINGLE is not set
# CONFIG_MACH_Z3Q_CAN_SINGLE is not set
CONFIG_MACH_Z3Q_CHN_OPEN=y
# CONFIG_MACH_Z3Q_JPN_SINGLE is not set

CONFIG_SAMSUNG_REAR_TOF=y
# CONFIG_SAMSUNG_REAR_TELE_BINNING is not set
CONFIG_SAMSUNG_REAR_TELE_TETRA=y

# CONFIG_PANEL_S6E3HA9_AMB611WE01_WQHD is not set
# CONFIG_PANEL_S6E3HA9_AMB644WF01_WQHD is not set
# CONFIG_PANEL_S6E3HAB_AMB677TY01_WQHD is not set
# CONFIG_PANEL_S6E3HAB_AMB623TS01_WQHD is not set
CONFIG_PANEL_S6E3HAB_AMB687TZ01_WQHD=y

CONFIG_WIRELESS_CHARGER_MFC_S2MIW04=y

# CONFIG_SENSORS_SX9360 is not set
CONFIG_SENSORS_A96T3X6=y
CONFIG_SENSORS_FW_VENDOR=y
CONFIG_SENSORS_A96T3X6_CRC_CHECK=y
CONFIG_SENSORS_A96T3X6_BLOCK_SAR_ONLY=y
CONFIG_SENSORS_A96T365IF=y
```

## drivers/fingerprint/Kconfig
```kconfig
#
# Sensor  drivers configuration
#
menuconfig SENSORS_FINGERPRINT
	bool "Finger Print Sensor devices"
	help
	  Say Y here, and a list of sensors drivers will be displayed.
	  Everything that didn't fit into the other categories is here. This option
	  doesn't affect the kernel.

if SENSORS_FINGERPRINT

config SENSORS_QBT2000
	tristate "QBT2000 fingerprint sensor support"
	default n
	help
	  If you say yes here you get support for Qualcomm's
	  fingerprint sensor QBT2000.

endif # SENSORS_FINGERPRINT
```

## drivers/gps/Kconfig
```kconfig
config GPS_BCMxxxxx
    bool "Common Broadcom GNSS chipset support"
	default n
	help
	  Say yes here to support for Broadcom GNSS chipset.

config GPS_BCM4752
    bool "GPS_BCM4752 Broadcom GNSS chipset support"
	default n
	help
	  Say yes here to support for Broadcom GPS_BCM4752 chipset.

config GPS_BCM47521
    bool "GPS_BCM47521 Broadcom GNSS chipset support"
	default n
    help
	  Say yes here to support for Broadcom GPS_BCM47521 chipset.

config GPS_BCM4753
    bool "GPS_BCM4753 Broadcom GNSS chipset support"
	default n
    help
	  Say yes here to support for Broadcom GPS_BCM4753 chipset.

config GPS_BCM47531
    bool "GPS_BCM47531 Broadcom GNSS chipset support"
	default n
    help
	  Say yes here to support for Broadcom GPS_BCM47531 chipset.

config GPS_BCM4773
    bool "GPS_BCM4773 Broadcom GNSS chipset support"
	default n
    help
	  Say yes here to support for Broadcom GPS_BCM4773 chipset.
```

## drivers/input/touchscreen/oppo_touchscreen/Novatek/Kconfig
```kconfig
source "drivers/input/touchscreen/oppo_touchscreen/Novatek/NT36672C_noflash/Kconfig"
```

## drivers/input/touchscreen/oppo_touchscreen/Novatek/NT36672C_noflash/Kconfig
```kconfig
#ifdef VENDOR_EDIT
#Added by Zhouwenping@Bsp.group.Tp for nova nt36672 ic driver

config TOUCHPANEL_NOVA_NT36672C_NOFLASH
#	default y
	bool "TP nova nt36672C IC enable or not for OPPO"
	---help---
	say Y to enable driver for Touchpanel useing nova nt36672

#endif
```

## drivers/sensors/Kconfig
```kconfig
# SPDX-License-Identifier: GPL-2.0-only
config SENSORS_SSC
	bool "Enable Sensors Driver Support for SSC"
	help
	  Add support for sensors SSC driver.
	  This driver is used for exercising sensors use case,
	  time syncing with ADSP clock.

config SENSORS
	bool "Sensors Class Support"
	help
	  This option enables the sensor sysfs class in /sys/class/sensors.
	  You'll need this to do anything useful with sensorss. If unsure, say N.

config SUPPORT_SSC_SPU
	bool "Support SSC(SLPI) SPU(System Parameter update)"
	help
	  Add support for SSC SPU.

config SENSORS_SX9360
	depends on I2C
	tristate "SX9360 driver"
	default n
	help
	  Say Y here if you use sx9360.
	  This option enables grip sensors using
	  SemTech sx9360 device driver.
	  Say N here if you do not use sx9360.

config SUPPORT_MCC_THRESHOLD_CHANGE
	depends on I2C
	tristate "Change grip sensor threshold according to the MCC value"
	default n
	help
	  Say Y here if you need to check mcc(mobile country code).
	  This option enables when it is necessary to adjust the threshold
	  according to the mcc value.
	  Say N here if you do not need to check mcc.

config SENSORS_A96T3X6
	tristate "a96t3x6 Grip sensor"
	default n
	help
	  Say Y here if you use a96t3x6.
	  This option enables grip sensors using
	  SemTech a96t3x6 device driver.
	  Say N here if you do not use a96t3x6.

config SENSORS_FW_VENDOR
	bool "Locate the Firmware on Vendor"
	default n
	help
	  To use the module automatic system, 
	  locate the firmware on vendor side.

config SENSORS_A96T3X6_CRC_CHECK
	bool "check crc check instead of checksum compare"
	default n
	help
	  Say Y here if you use crc check instead of checksum compare

config SENSORS_A96T3X6_BLOCK_SAR_ONLY
	tristate "Prevent entering sar only mode"
	default n
	help
	  Prevent entering sar only mode.

config SENSORS_A96T365IF
	bool "Choose A96T365IF"
	default n
	help
```
